## build/conf/bblayers.conf
```bitbake
POKY_BBLAYERS_CONF_VERSION = "2"

BBPATH = "${TOPDIR}"
BBFILES ?= ""

# Adjust all paths below to match where you cloned each layer
BBLAYERS ?= " \
  /opt/yocto/poky/meta \
  /opt/yocto/poky/meta-poky \
  /opt/yocto/poky/meta-yocto-bsp \
  /opt/yocto/meta-openembedded/meta-oe \
  /opt/yocto/meta-openembedded/meta-python \
  /opt/yocto/meta-openembedded/meta-networking \
  /opt/yocto/meta-openembedded/meta-multimedia \
  /opt/yocto/meta-raspberrypi \
  ${TOPDIR}/../meta-rpi-detector \
"
```

## meta-rpi-detector/conf/layer.conf
```bitbake
BBPATH .= ":${LAYERDIR}"

BBFILES += "${LAYERDIR}/recipes-*/*/*.bb \
             ${LAYERDIR}/recipes-*/*/*.bbappend"

BBFILE_COLLECTIONS += "rpi-detector"
BBFILE_PATTERN_rpi-detector = "^${LAYERDIR}/"
BBFILE_PRIORITY_rpi-detector = "6"

LAYERVERSION_rpi-detector = "1"
LAYERDEPENDS_rpi-detector = "core openembedded-layer meta-python networking-layer"
LAYERSERIES_COMPAT_rpi-detector = "kirkstone"
```
